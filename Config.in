## Config.in
```kconfig
config BR2_RASPAUDIO_PAACCESS
	string "pulseaudio access list"
	default ""
	help
	   A semicolon separated list of IP address range to which anonymous access is
	   allowed. Example: 10.11.12.13;192.168.50.0/24;127.0.0.0/8
	   
	   if left empty, no authentification will be required.
```

## raspaudio_defconfig
```kconfig
BR2_arm=y
BR2_arm1176jzf_s=y
BR2_DL_DIR="$(BR2_EXTERNAL)/dl"
BR2_PACKAGE_OVERRIDE_FILE="$(BR2_EXTERNAL)/$(PROJECT_NAME)_local.mk"
BR2_GLOBAL_PATCH_DIR="$(BR2_EXTERNAL)/$(PRJECT_NAME)_patch"
BR2_KERNEL_HEADERS_VERSION=y
BR2_DEFAULT_KERNEL_VERSION="3.12.26"
BR2_PACKAGE_HOST_LINUX_HEADERS_CUSTOM_3_12=y
BR2_TOOLCHAIN_BUILDROOT_LARGEFILE=y
BR2_TOOLCHAIN_BUILDROOT_WCHAR=y
BR2_TOOLCHAIN_BUILDROOT_CXX=y
BR2_TARGET_GENERIC_HOSTNAME="Raspaudio"
BR2_TARGET_GENERIC_ISSUE="Raspaudio"
BR2_ROOTFS_DEVICE_CREATION_DYNAMIC_EUDEV=y
BR2_TARGET_GENERIC_GETTY_PORT="ttyAMA0"
BR2_ROOTFS_OVERLAY="$(BR2_EXTERNAL)/$(PROJECT_NAME)_overlay"
BR2_ROOTFS_POST_BUILD_SCRIPT="$(BR2_EXTERNAL)/add_ssh_key.sh $(BR2_EXTERNAL)/raspaudio_adjust.sh"
BR2_LINUX_KERNEL=y
BR2_LINUX_KERNEL_CUSTOM_GIT=y
BR2_LINUX_KERNEL_CUSTOM_REPO_URL="git://github.com/raspberrypi/linux.git"
BR2_LINUX_KERNEL_CUSTOM_REPO_VERSION="353043394c99ed37a4075da228af64468fdf6c06"
BR2_LINUX_KERNEL_DEFCONFIG="bcmrpi"
BR2_LINUX_KERNEL_ZIMAGE=y
BR2_PACKAGE_BUSYBOX_CONFIG="$(BR2_EXTERNAL)/busybox-config"
BR2_PACKAGE_ALSA_UTILS=y
BR2_PACKAGE_ALSA_UTILS_ALSACONF=y
BR2_PACKAGE_ALSA_UTILS_APLAY=y
BR2_PACKAGE_PULSEAUDIO=y
BR2_PACKAGE_PULSEAUDIO_DAEMON=y
BR2_PACKAGE_RPI_FIRMWARE=y
BR2_PACKAGE_DBUS=y
BR2_PACKAGE_RPI_USERLAND=y
BR2_PACKAGE_LIBCOFI=y
BR2_PACKAGE_AVAHI=y
# BR2_PACKAGE_AVAHI_AUTOIPD is not set
BR2_PACKAGE_AVAHI_DAEMON=y
BR2_PACKAGE_NTP=y
BR2_PACKAGE_NTP_NTPDATE=y
BR2_PACKAGE_OPENSSH=y
```
